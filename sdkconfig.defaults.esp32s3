## sdkconfig.defaults.esp32s3
```kconfig
CONFIG_ESP_CONSOLE_USB_SERIAL_JTAG=y
CONFIG_ESP_WIFI_CSI_ENABLED=y
CONFIG_EXAMPLE_WIFI_SSID="YOUR_WIFI_NAME"
CONFIG_EXAMPLE_WIFI_PASSWORD="YOUR_WIFI_PASSWORD"
```
